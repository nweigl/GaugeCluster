/*
    i2c OLED Display.
	Derived from Adafruit examples in the Adafruit_GFX and Adafruit_SSD1306 libraries.
*/
#include <Arduino.h>
#include <Wire.h>
#include <Adafruit_GFX.h>
#include <Adafruit_SSD1306.h>
#include <Adafruit_I2CDevice.h>
#include <Fonts/FreeSerifBold12pt7b.h>>
#include <string.h>
#include "DataDisplay.h"

#define SCREEN_WIDTH 128 // OLED display width, in pixels
#define SCREEN_HEIGHT 32 // OLED display height, in pixels

// Declaration for an SSD1306 display connected to I2C (SDA, SCL pins)
// The pins for I2C are defined by the Wire-library. 
// On an arduino UNO:       A4(SDA), A5(SCL)
// On an arduino MEGA 2560: 20(SDA), 21(SCL)
// On an arduino LEONARDO:   2(SDA),  3(SCL), ...
#define OLED_RESET -1 // Reset pin # (or -1 if sharing Arduino reset pin)
#define SCREEN_ADDRESS 0x3C ///< See datasheet for Address; 0x3D for 128x64, 0x3C for 128x32
Adafruit_SSD1306 display(SCREEN_WIDTH, SCREEN_HEIGHT, &Wire, OLED_RESET);

const unsigned char PROGMEM bowtie[] = {
	0x00, 0x00, 0x00, 0x00, 0x00, 0x00, 0xff, 0xff, 0xff, 0xff, 0x00, 0x00, 0x00, 0x00, 0x00, 0x00, 
	0x00, 0x00, 0x00, 0x00, 0x00, 0x00, 0xff, 0xff, 0xff, 0xff, 0x00, 0x00, 0x00, 0x00, 0x00, 0x00, 
	0x00, 0x00, 0x00, 0x00, 0x00, 0x00, 0xff, 0xff, 0xff, 0xff, 0x00, 0x00, 0x00, 0x00, 0x00, 0x00, 
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	0x00, 0x00, 0x00, 0x00, 0x00, 0x00, 0xff, 0xff, 0xff, 0xff, 0x00, 0x00, 0x00, 0x00, 0x00, 0x00
};

DataDisplay::DataDisplay() {
}

void DataDisplay::setup() {
  Serial.begin(9600);

  // SSD1306_SWITCHCAPVCC = generate display voltage from 3.3V internally
  if(!display.begin(SSD1306_SWITCHCAPVCC, SCREEN_ADDRESS)) {
    Serial.println(F("SSD1306 allocation failed"));
    for(;;); // Don't proceed, loop forever
  }

  drawBowtie();
}

void DataDisplay::drawOdometer(long miles) {
	if (miles > 9999999)
	{
		miles = 9999999;
	}
	else if (miles < 0)
	{
		miles = 0;
	}
	char buffer[7];

	sprintf(buffer, "%07ld", miles);
	display.clearDisplay();
	display.setFont(&FreeSerifBold12pt7b);
	display.setTextColor(SSD1306_WHITE);
	
	for (int i = 0; i < 6; i++) {	
		display.setCursor(18*i+3, 22);
		display.print(buffer[i]);
		display.drawLine(18 * i, 0, 18 * i, 32, SSD1306_WHITE);
	}

	display.setTextColor(SSD1306_BLACK); // Draw 'inverse' text
	display.setCursor(18*6+3, 22);
	display.fillRect(18*6+2, 0, 16, 32, SSD1306_WHITE);
	display.print(buffer[6]);
	display.drawLine(18 * 6, 0, 18 * 6, 32, SSD1306_WHITE);
	display.drawLine(127, 0, 127, 32, SSD1306_WHITE);
	display.display();
}

void DataDisplay::drawBowtie(void) {
  display.clearDisplay();

  display.drawBitmap(0, 0, bowtie, display.width(), display.height(), 1);
  display.display();
  delay(2000);
}
